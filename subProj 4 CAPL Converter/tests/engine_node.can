/* Mock CAPL syntax for Engine ECU simulation */
variables {
  message 0x100 msg_engine;
  msTimer myTimer;
}

on start {
  write("Engine ECU node started. Setting timer to 20ms.");
  setTimer(myTimer, 20);
}

on timer myTimer {
  msg_engine.byte(0) = 0xAA;
  msg_engine.byte(1) = 0xBB;
  
  output(msg_engine);
  
  /* Reset timer for cyclical transmission */
  setTimer(myTimer, 20);
}
